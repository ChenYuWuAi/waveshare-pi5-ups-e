/dts-v1/;
/plugin/;
/{
	compatible = "brcm,bcm2712";
	
	fragment@0 {
		target = <&i2c1>;
		__overlay__ {
			#address-cells = <1>;
			#size-cells = <0>;
			ups: rpi_ups@2d {
				compatible = "rpi,ups";
				status = "okay";
				reg = <0x2d>;
			};
		};
	};
};
